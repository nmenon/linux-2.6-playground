/*
 * TPS62361 entries specific for OMAP
 *
 * Copyright (C) 2013 Texas Instruments Incorporated - http://www.ti.com/
 *	Nishanth Menon
 *
 * This program is free software; you can redistribute it and/or modify
 * it under the terms of the GNU General Public License version 2 as
 * published by the Free Software Foundation.
 */

/ {
	omap_tps62361: tps62361 {
		compatible = "ti,omap-tps62361";
		ti,boot-voltage-micro-volts = <1203000>;
		ti,vp = <&vp_mpu>;
	};
};
